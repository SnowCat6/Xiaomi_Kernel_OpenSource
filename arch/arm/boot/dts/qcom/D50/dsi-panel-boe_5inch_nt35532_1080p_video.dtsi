/* Copyright (c) 2014, The Linux Foundation. All rights reserved.
 *
 * This program is free software; you can redistribute it and/or modify
 * it under the terms of the GNU General Public License version 2 and
 * only version 2 as published by the Free Software Foundation.
 *
 * This program is distributed in the hope that it will be useful,
 * but WITHOUT ANY WARRANTY; without even the implied warranty of
 * MERCHANTABILITY or FITNESS FOR A PARTICULAR PURPOSE.  See the
 * GNU General Public License for more details.
 */

&mdss_mdp {
	dsi_boe_5inch_nt35532_1080p_video: qcom,mdss_dsi_boe_5inch_nt35532_1080p_video {
		qcom,mdss-dsi-panel-name = "nt35596 1080p video mode dsi panel skuk";
		qcom,cont-splash-enabled;
		qcom,mdss-dsi-panel-controller = <&mdss_dsi0>;
		qcom,mdss-dsi-panel-type = "dsi_video_mode";
		qcom,mdss-dsi-panel-destination = "display_1";
		qcom,mdss-dsi-panel-framerate = <0x3c>;
		qcom,mdss-dsi-virtual-channel-id = <0x0>;
		qcom,mdss-dsi-stream = <0x0>;
		qcom,mdss-dsi-panel-width = <0x438>;
		qcom,mdss-dsi-panel-height = <0x780>;
		qcom,mdss-dsi-h-front-porch = <0x64>;
		qcom,mdss-dsi-h-back-porch = <0x52>;
		qcom,mdss-dsi-h-pulse-width = <0x8>;
		qcom,mdss-dsi-h-sync-skew = <0x0>;
		qcom,mdss-dsi-v-back-porch = <0x7>;
		qcom,mdss-dsi-v-front-porch = <0x3>;
		qcom,mdss-dsi-v-pulse-width = <0x2>;
		qcom,mdss-dsi-bpp = <0x18>;
		qcom,mdss-dsi-color-order = "rgb_swap_rgb";
		qcom,mdss-dsi-underflow-color = <0xff>;
		qcom,mdss-dsi-border-color = <0x0>;
		qcom,mdss-dsi-on-command = [29 01 00 00 00 00 02 ff 01 29 01 00 00 00 00 02 fb 01 29 01 00 00 0a 00 02 00 01 29 01 00 00 14 00 02 01 55 29 01 00 00 00 00 02 02 59 29 01 00 00 05 00 02 04 0c 29 01 00 00 00 00 02 05 2a 29 01 00 00 00 00 02 06 46 29 01 00 00 00 00 02 07 a8 29 01 00 00 00 00 02 0d 9d 29 01 00 00 00 00 02 0e 9d 29 01 00 00 00 00 02 0f 60 29 01 00 00 00 00 02 10 03 29 01 00 00 00 00 02 11 3c 29 01 00 00 00 00 02 12 3c 29 01 00 00 00 00 02 13 75 29 01 00 00 00 00 02 14 75 29 01 00 00 00 00 02 15 60 29 01 00 00 00 00 02 16 12 29 01 00 00 00 00 02 17 12 29 01 00 00 00 00 02 68 13 29 01 00 00 00 00 02 6d 33 29 01 00 00 00 00 02 75 00 29 01 00 00 00 00 02 76 00 29 01 00 00 00 00 02 77 00 29 01 00 00 00 00 02 78 1e 29 01 00 00 00 00 02 79 00 29 01 00 00 00 00 02 7a 4b 29 01 00 00 00 00 02 7b 00 29 01 00 00 00 00 02 7c 6e 29 01 00 00 00 00 02 7d 00 29 01 00 00 00 00 02 7e 88 29 01 00 00 00 00 02 7f 00 29 01 00 00 00 00 02 80 9f 29 01 00 00 00 00 02 81 00 29 01 00 00 00 00 02 82 b3 29 01 00 00 00 00 02 83 00 29 01 00 00 00 00 02 84 c5 29 01 00 00 00 00 02 85 00 29 01 00 00 00 00 02 86 d5 29 01 00 00 00 00 02 87 01 29 01 00 00 00 00 02 88 09 29 01 00 00 00 00 02 89 01 29 01 00 00 00 00 02 8a 31 29 01 00 00 00 00 02 8b 01 29 01 00 00 00 00 02 8c 6b 29 01 00 00 00 00 02 8d 01 29 01 00 00 00 00 02 8e 97 29 01 00 00 00 00 02 8f 01 29 01 00 00 00 00 02 90 d8 29 01 00 00 00 00 02 91 02 29 01 00 00 00 00 02 92 0c 29 01 00 00 00 00 02 93 02 29 01 00 00 00 00 02 94 0d 29 01 00 00 00 00 02 95 02 29 01 00 00 00 00 02 96 3f 29 01 00 00 00 00 02 97 02 29 01 00 00 00 00 02 98 77 29 01 00 00 00 00 02 99 02 29 01 00 00 00 00 02 9a 9c 29 01 00 00 00 00 02 9b 02 29 01 00 00 00 00 02 9c cf 29 01 00 00 00 00 02 9d 02 29 01 00 00 00 00 02 9e f0 29 01 00 00 00 00 02 9f 03 29 01 00 00 00 00 02 a0 1c 29 01 00 00 00 00 02 a2 03 29 01 00 00 00 00 02 a3 29 29 01 00 00 00 00 02 a4 03 29 01 00 00 00 00 02 a5 37 29 01 00 00 00 00 02 a6 03 29 01 00 00 00 00 02 a7 47 29 01 00 00 00 00 02 a9 03 29 01 00 00 00 00 02 aa 58 29 01 00 00 00 00 02 ab 03 29 01 00 00 00 00 02 ac 6c 29 01 00 00 00 00 02 ad 03 29 01 00 00 00 00 02 ae 80 29 01 00 00 00 00 02 af 03 29 01 00 00 00 00 02 b0 f4 29 01 00 00 00 00 02 b1 03 29 01 00 00 00 00 02 b2 ff 29 01 00 00 00 00 02 b3 00 29 01 00 00 00 00 02 b4 00 29 01 00 00 00 00 02 b5 00 29 01 00 00 00 00 02 b6 1e 29 01 00 00 00 00 02 b7 00 29 01 00 00 00 00 02 b8 4b 29 01 00 00 00 00 02 b9 00 29 01 00 00 05 00 02 ba 6e 29 01 00 00 00 00 02 bb 00 29 01 00 00 00 00 02 bc 88 29 01 00 00 00 00 02 bd 00 29 01 00 00 00 00 02 be 9f 29 01 00 00 00 00 02 bf 00 29 01 00 00 00 00 02 c0 b3 29 01 00 00 00 00 02 c1 00 29 01 00 00 00 00 02 c2 c5 29 01 00 00 00 00 02 c3 00 29 01 00 00 00 00 02 c4 d5 29 01 00 00 00 00 02 c5 01 29 01 00 00 00 00 02 c6 09 29 01 00 00 00 00 02 c7 01 29 01 00 00 00 00 02 c8 31 29 01 00 00 00 00 02 c9 01 29 01 00 00 00 00 02 ca 6b 29 01 00 00 00 00 02 cb 01 29 01 00 00 00 00 02 cc 97 29 01 00 00 00 00 02 cd 01 29 01 00 00 00 00 02 ce d8 29 01 00 00 00 00 02 cf 02 29 01 00 00 00 00 02 d0 0c 29 01 00 00 00 00 02 d1 02 29 01 00 00 00 00 02 d2 0d 29 01 00 00 00 00 02 d3 02 29 01 00 00 00 00 02 d4 3f 29 01 00 00 00 00 02 d5 02 29 01 00 00 00 00 02 d6 77 29 01 00 00 00 00 02 d7 02 29 01 00 00 00 00 02 d8 9c 29 01 00 00 00 00 02 d9 02 29 01 00 00 00 00 02 da cf 29 01 00 00 00 00 02 db 02 29 01 00 00 00 00 02 dc f0 29 01 00 00 00 00 02 dd 03 29 01 00 00 00 00 02 de 1c 29 01 00 00 00 00 02 df 03 29 01 00 00 00 00 02 e0 29 29 01 00 00 00 00 02 e1 03 29 01 00 00 00 00 02 e2 37 29 01 00 00 00 00 02 e3 03 29 01 00 00 00 00 02 e4 47 29 01 00 00 00 00 02 e5 03 29 01 00 00 00 00 02 e6 58 29 01 00 00 00 00 02 e7 03 29 01 00 00 00 00 02 e8 6c 29 01 00 00 00 00 02 e9 03 29 01 00 00 00 00 02 ea 80 29 01 00 00 00 00 02 eb 03 29 01 00 00 00 00 02 ec f4 29 01 00 00 00 00 02 ed 03 29 01 00 00 00 00 02 ee ff 29 01 00 00 00 00 02 ef 00 29 01 00 00 00 00 02 f0 00 29 01 00 00 00 00 02 f1 00 29 01 00 00 00 00 02 f2 1e 29 01 00 00 00 00 02 f3 00 29 01 00 00 00 00 02 f4 4b 29 01 00 00 00 00 02 f5 00 29 01 00 00 00 00 02 f6 6e 29 01 00 00 00 00 02 f7 00 29 01 00 00 00 00 02 f8 88 29 01 00 00 00 00 02 f9 00 29 01 00 00 00 00 02 fa 9f 29 01 00 00 00 00 02 ff 02 29 01 00 00 00 00 02 fb 01 29 01 00 00 00 00 02 00 00 29 01 00 00 00 00 02 01 b3 29 01 00 00 00 00 02 02 00 29 01 00 00 00 00 02 03 c5 29 01 00 00 00 00 02 04 00 29 01 00 00 00 00 02 05 d5 29 01 00 00 00 00 02 06 01 29 01 00 00 00 00 02 07 09 29 01 00 00 00 00 02 08 01 29 01 00 00 00 00 02 09 31 29 01 00 00 00 00 02 0a 01 29 01 00 00 00 00 02 0b 6b 29 01 00 00 00 00 02 0c 01 29 01 00 00 00 00 02 0d 97 29 01 00 00 00 00 02 0e 01 29 01 00 00 00 00 02 0f d8 29 01 00 00 00 00 02 10 02 29 01 00 00 00 00 02 11 0c 29 01 00 00 00 00 02 12 02 29 01 00 00 00 00 02 13 0d 29 01 00 00 00 00 02 14 02 29 01 00 00 00 00 02 15 3f 29 01 00 00 00 00 02 16 02 29 01 00 00 00 00 02 17 77 29 01 00 00 00 00 02 18 02 29 01 00 00 00 00 02 19 9c 29 01 00 00 00 00 02 1a 02 29 01 00 00 00 00 02 1b cf 29 01 00 00 00 00 02 1c 02 29 01 00 00 00 00 02 1d f0 29 01 00 00 00 00 02 1e 03 29 01 00 00 00 00 02 1f 1c 29 01 00 00 00 00 02 20 03 29 01 00 00 00 00 02 21 29 29 01 00 00 00 00 02 22 03 29 01 00 00 00 00 02 23 37 29 01 00 00 00 00 02 24 03 29 01 00 00 00 00 02 25 47 29 01 00 00 00 00 02 26 03 29 01 00 00 00 00 02 27 58 29 01 00 00 00 00 02 28 03 29 01 00 00 00 00 02 29 6c 29 01 00 00 00 00 02 2a 03 29 01 00 00 00 00 02 2b 80 29 01 00 00 00 00 02 2d 03 29 01 00 00 00 00 02 2f f4 29 01 00 00 00 00 02 30 03 29 01 00 00 00 00 02 31 ff 29 01 00 00 00 00 02 32 00 29 01 00 00 00 00 02 33 00 29 01 00 00 00 00 02 34 00 29 01 00 00 00 00 02 35 1e 29 01 00 00 00 00 02 36 00 29 01 00 00 00 00 02 37 4b 29 01 00 00 00 00 02 38 00 29 01 00 00 00 00 02 39 6e 29 01 00 00 00 00 02 3a 00 29 01 00 00 00 00 02 3b 88 29 01 00 00 00 00 02 3d 00 29 01 00 00 00 00 02 3f 9f 29 01 00 00 00 00 02 40 00 29 01 00 00 00 00 02 41 b3 29 01 00 00 00 00 02 42 00 29 01 00 00 00 00 02 43 c5 29 01 00 00 00 00 02 44 00 29 01 00 00 00 00 02 45 d5 29 01 00 00 00 00 02 46 01 29 01 00 00 00 00 02 47 09 29 01 00 00 00 00 02 48 01 29 01 00 00 00 00 02 49 31 29 01 00 00 00 00 02 4a 01 29 01 00 00 00 00 02 4b 6b 29 01 00 00 00 00 02 4c 01 29 01 00 00 00 00 02 4d 97 29 01 00 00 00 00 02 4e 01 29 01 00 00 00 00 02 4f d8 29 01 00 00 00 00 02 50 02 29 01 00 00 00 00 02 51 0c 29 01 00 00 00 00 02 52 02 29 01 00 00 00 00 02 53 0d 29 01 00 00 00 00 02 54 02 29 01 00 00 05 00 02 55 3f 29 01 00 00 00 00 02 56 02 29 01 00 00 00 00 02 58 77 29 01 00 00 00 00 02 59 02 29 01 00 00 00 00 02 5a 9c 29 01 00 00 00 00 02 5b 02 29 01 00 00 00 00 02 5c cf 29 01 00 00 00 00 02 5d 02 29 01 00 00 00 00 02 5e f0 29 01 00 00 00 00 02 5f 03 29 01 00 00 00 00 02 60 1c 29 01 00 00 00 00 02 61 03 29 01 00 00 00 00 02 62 29 29 01 00 00 00 00 02 63 03 29 01 00 00 00 00 02 64 37 29 01 00 00 00 00 02 65 03 29 01 00 00 00 00 02 66 47 29 01 00 00 00 00 02 67 03 29 01 00 00 00 00 02 68 58 29 01 00 00 00 00 02 69 03 29 01 00 00 00 00 02 6a 6c 29 01 00 00 00 00 02 6b 03 29 01 00 00 00 00 02 6c 80 29 01 00 00 00 00 02 6d 03 29 01 00 00 00 00 02 6e f4 29 01 00 00 00 00 02 6f 03 29 01 00 00 00 00 02 70 ff 29 01 00 00 00 00 02 71 00 29 01 00 00 00 00 02 72 00 29 01 00 00 00 00 02 73 00 29 01 00 00 00 00 02 74 1e 29 01 00 00 00 00 02 75 00 29 01 00 00 00 00 02 76 4b 29 01 00 00 00 00 02 77 00 29 01 00 00 00 00 02 78 6e 29 01 00 00 00 00 02 79 00 29 01 00 00 00 00 02 7a 88 29 01 00 00 00 00 02 7b 00 29 01 00 00 00 00 02 7c 9f 29 01 00 00 00 00 02 7d 00 29 01 00 00 00 00 02 7e b3 29 01 00 00 00 00 02 7f 00 29 01 00 00 00 00 02 80 c5 29 01 00 00 00 00 02 81 00 29 01 00 00 00 00 02 82 d5 29 01 00 00 00 00 02 83 01 29 01 00 00 00 00 02 84 09 29 01 00 00 00 00 02 85 01 29 01 00 00 00 00 02 86 31 29 01 00 00 00 00 02 87 01 29 01 00 00 00 00 02 88 6b 29 01 00 00 00 00 02 89 01 29 01 00 00 00 00 02 8a 97 29 01 00 00 00 00 02 8b 01 29 01 00 00 00 00 02 8c d8 29 01 00 00 00 00 02 8d 02 29 01 00 00 00 00 02 8e 0c 29 01 00 00 00 00 02 8f 02 29 01 00 00 00 00 02 90 0d 29 01 00 00 00 00 02 91 02 29 01 00 00 00 00 02 92 3f 29 01 00 00 00 00 02 93 02 29 01 00 00 00 00 02 94 77 29 01 00 00 00 00 02 95 02 29 01 00 00 00 00 02 96 9c 29 01 00 00 00 00 02 97 02 29 01 00 00 00 00 02 98 cf 29 01 00 00 00 00 02 99 02 29 01 00 00 00 00 02 9a f0 29 01 00 00 00 00 02 9b 03 29 01 00 00 00 00 02 9c 1c 29 01 00 00 00 00 02 9d 03 29 01 00 00 00 00 02 9e 29 29 01 00 00 00 00 02 9f 03 29 01 00 00 00 00 02 a0 37 29 01 00 00 00 00 02 a2 03 29 01 00 00 00 00 02 a3 47 29 01 00 00 00 00 02 a4 03 29 01 00 00 00 00 02 a5 58 29 01 00 00 00 00 02 a6 03 29 01 00 00 00 00 02 a7 6c 29 01 00 00 00 00 02 a9 03 29 01 00 00 00 00 02 aa 80 29 01 00 00 00 00 02 ab 03 29 01 00 00 00 00 02 ac f4 29 01 00 00 00 00 02 ad 03 29 01 00 00 00 00 02 ae ff 29 01 00 00 00 00 02 af 00 29 01 00 00 00 00 02 b0 00 29 01 00 00 00 00 02 b1 00 29 01 00 00 00 00 02 b2 1e 29 01 00 00 00 00 02 b3 00 29 01 00 00 00 00 02 b4 4b 29 01 00 00 00 00 02 b5 00 29 01 00 00 00 00 02 b6 6e 29 01 00 00 00 00 02 b7 00 29 01 00 00 00 00 02 b8 88 29 01 00 00 00 00 02 b9 00 29 01 00 00 00 00 02 ba 9f 29 01 00 00 00 00 02 bb 00 29 01 00 00 00 00 02 bc b3 29 01 00 00 00 00 02 bd 00 29 01 00 00 00 00 02 be c5 29 01 00 00 00 00 02 bf 00 29 01 00 00 00 00 02 c0 d5 29 01 00 00 00 00 02 c1 01 29 01 00 00 00 00 02 c2 09 29 01 00 00 00 00 02 c3 01 29 01 00 00 00 00 02 c4 31 29 01 00 00 00 00 02 c5 01 29 01 00 00 00 00 02 c6 6b 29 01 00 00 00 00 02 c7 01 29 01 00 00 00 00 02 c8 97 29 01 00 00 00 00 02 c9 01 29 01 00 00 00 00 02 ca d8 29 01 00 00 00 00 02 cb 02 29 01 00 00 00 00 02 cc 0c 29 01 00 00 00 00 02 cd 02 29 01 00 00 00 00 02 ce 0d 29 01 00 00 00 00 02 cf 02 29 01 00 00 00 00 02 d0 3f 29 01 00 00 00 00 02 d1 02 29 01 00 00 00 00 02 d2 77 29 01 00 00 00 00 02 d3 02 29 01 00 00 00 00 02 d4 9c 29 01 00 00 00 00 02 d5 02 29 01 00 00 00 00 02 d6 cf 29 01 00 00 00 00 02 d7 02 29 01 00 00 00 00 02 d8 f0 29 01 00 00 00 00 02 d9 03 29 01 00 00 00 00 02 da 1c 29 01 00 00 00 00 02 db 03 29 01 00 00 00 00 02 dc 29 29 01 00 00 00 00 02 dd 03 29 01 00 00 00 00 02 de 37 29 01 00 00 00 00 02 df 03 29 01 00 00 00 00 02 e0 47 29 01 00 00 00 00 02 e1 03 29 01 00 00 00 00 02 e2 58 29 01 00 00 00 00 02 e3 03 29 01 00 00 00 00 02 e4 6c 29 01 00 00 00 00 02 e5 03 29 01 00 00 00 00 02 e6 80 29 01 00 00 00 00 02 e7 03 29 01 00 00 00 00 02 e8 f4 29 01 00 00 00 00 02 e9 03 29 01 00 00 00 00 02 ea ff 29 01 00 00 00 00 02 ff 05 29 01 00 00 00 00 02 fb 01 29 01 00 00 00 00 02 00 40 29 01 00 00 00 00 02 01 40 29 01 00 00 00 00 02 02 09 29 01 00 00 00 00 02 03 07 29 01 00 00 00 00 02 04 04 29 01 00 00 00 00 02 05 1d 29 01 00 00 00 00 02 06 1d 29 01 00 00 00 00 02 07 1b 29 01 00 00 00 00 02 08 1b 29 01 00 00 00 00 02 09 19 29 01 00 00 00 00 02 0a 19 29 01 00 00 00 00 02 0b 17 29 01 00 00 00 00 02 0c 17 29 01 00 00 00 00 02 0d 05 29 01 00 00 00 00 02 0e 40 29 01 00 00 00 00 02 0f 40 29 01 00 00 00 00 02 10 40 29 01 00 00 00 00 02 11 40 29 01 00 00 00 00 02 12 40 29 01 00 00 00 00 02 13 40 29 01 00 00 00 00 02 14 40 29 01 00 00 00 00 02 15 40 29 01 00 00 00 00 02 16 08 29 01 00 00 00 00 02 17 06 29 01 00 00 00 00 02 18 04 29 01 00 00 00 00 02 19 1c 29 01 00 00 00 00 02 1a 1c 29 01 00 00 00 00 02 1b 1a 29 01 00 00 00 00 02 1c 1a 29 01 00 00 00 00 02 1d 18 29 01 00 00 00 00 02 1e 18 29 01 00 00 00 00 02 1f 16 29 01 00 00 00 00 02 20 16 29 01 00 00 00 00 02 21 05 29 01 00 00 00 00 02 22 40 29 01 00 00 00 00 02 23 40 29 01 00 00 00 00 02 24 40 29 01 00 00 00 00 02 25 40 29 01 00 00 00 00 02 26 40 29 01 00 00 00 00 02 27 40 29 01 00 00 00 00 02 28 40 29 01 00 00 00 00 02 29 40 29 01 00 00 00 00 02 2a 06 29 01 00 00 00 00 02 2b 08 29 01 00 00 00 00 02 2d 04 29 01 00 00 00 00 02 2f 16 29 01 00 00 00 00 02 30 16 29 01 00 00 00 00 02 31 18 29 01 00 00 00 00 02 32 18 29 01 00 00 00 00 02 33 1a 29 01 00 00 00 00 02 34 1a 29 01 00 00 00 00 02 35 1c 29 01 00 00 00 00 02 36 1c 29 01 00 00 00 00 02 37 05 29 01 00 00 00 00 02 38 40 29 01 00 00 00 00 02 39 40 29 01 00 00 00 00 02 3a 40 29 01 00 00 00 00 02 3b 40 29 01 00 00 00 00 02 3d 40 29 01 00 00 00 00 02 3f 40 29 01 00 00 00 00 02 40 40 29 01 00 00 00 00 02 41 40 29 01 00 00 00 00 02 42 07 29 01 00 00 00 00 02 43 09 29 01 00 00 00 00 02 44 04 29 01 00 00 00 00 02 45 17 29 01 00 00 00 00 02 46 17 29 01 00 00 00 00 02 47 19 29 01 00 00 00 00 02 48 19 29 01 00 00 00 00 02 49 1b 29 01 00 00 00 00 02 4a 1b 29 01 00 00 00 00 02 4b 1d 29 01 00 00 00 00 02 4c 1d 29 01 00 00 00 00 02 4d 05 29 01 00 00 00 00 02 4e 40 29 01 00 00 00 00 02 4f 40 29 01 00 00 00 00 02 50 40 29 01 00 00 00 00 02 51 40 29 01 00 00 00 00 02 52 40 29 01 00 00 00 00 02 53 40 29 01 00 00 00 00 02 54 0e 29 01 00 00 00 00 02 55 0c 29 01 00 00 00 00 02 59 1b 29 01 00 00 00 00 02 5b 02 29 01 00 00 05 00 02 5c 02 29 01 00 00 00 00 02 5d 01 29 01 00 00 00 00 02 65 80 29 01 00 00 00 00 02 66 53 29 01 00 00 00 00 02 67 11 29 01 00 00 00 00 02 68 6b 29 01 00 00 00 00 02 69 12 29 01 00 00 00 00 02 6a 0b 29 01 00 00 00 00 02 6b 24 29 01 00 00 00 00 02 6c 00 29 01 00 00 00 00 02 77 00 29 01 00 00 00 00 02 78 00 29 01 00 00 00 00 02 79 00 29 01 00 00 00 00 02 7c 40 29 01 00 00 00 00 02 7d 0d 29 01 00 00 00 00 02 7e 00 29 01 00 00 05 00 02 7f 00 29 01 00 00 00 00 02 80 00 29 01 00 00 00 00 02 81 00 29 01 00 00 00 00 02 84 70 29 01 00 00 00 00 02 bb ee 29 01 00 00 00 00 02 b8 05 29 01 00 00 00 00 02 ba 13 29 01 00 00 00 00 02 bc 95 29 01 00 00 00 00 02 bd a6 29 01 00 00 00 00 02 be 08 29 01 00 00 00 00 02 bf a3 29 01 00 00 00 00 02 c8 55 29 01 00 00 00 00 02 c9 55 29 01 00 00 00 00 02 cc 52 29 01 00 00 00 00 02 cf 88 29 01 00 00 00 00 02 d0 00 29 01 00 00 05 00 02 d1 00 29 01 00 00 00 00 02 90 7b 29 01 00 00 00 00 02 91 10 29 01 00 00 00 00 02 92 10 29 01 00 00 00 00 02 98 00 29 01 00 00 00 00 02 99 00 29 01 00 00 00 00 02 9f 0f 29 01 00 00 00 00 02 d6 42 29 01 00 00 00 00 02 a2 b0 29 01 00 00 00 00 02 ff ee 29 01 00 00 05 00 02 30 60 29 01 00 00 00 00 02 ff 00 29 01 00 00 00 00 02 d3 10 29 01 00 00 00 00 02 d4 10 29 01 00 00 00 00 02 d5 0a 29 01 00 00 00 00 02 d6 0a 29 01 00 00 00 00 02 51 00 29 01 00 00 00 00 02 53 2c 29 01 00 00 00 00 02 55 00 29 01 00 00 78 00 02 11 00 29 01 00 00 00 00 02 29 00];
		qcom,mdss-dsi-off-command = [05 01 00 00 32 00 02 28 00 05 01 00 00 78 00 02 10 00];
		qcom,mdss-dsi-on-command-state = "dsi_lp_mode";
		qcom,mdss-dsi-off-command-state = "dsi_hs_mode";
		qcom,mdss-dsi-h-sync-pulse = <0x1>;
		qcom,mdss-dsi-traffic-mode = "burst_mode";
		qcom,mdss-dsi-lane-map = "lane_map_0123";
		qcom,mdss-dsi-bllp-eof-power-mode;
		qcom,mdss-dsi-bllp-power-mode;
		qcom,mdss-dsi-lane-0-state;
		qcom,mdss-dsi-lane-1-state;
		qcom,mdss-dsi-lane-2-state;
		qcom,mdss-dsi-lane-3-state;
		qcom,mdss-dsi-panel-timings = <0x9e433700 0x60583945 0x5b030400>;
		qcom,mdss-dsi-t-clk-post = <0x1e>;
		qcom,mdss-dsi-t-clk-pre = <0x38>;
		qcom,mdss-dsi-bl-min-level = <0x1>;
		qcom,mdss-dsi-bl-max-level = <0xff>;
		qcom,mdss-dsi-dma-trigger = "trigger_sw";
		qcom,mdss-dsi-mdp-trigger = "none";
		qcom,mdss-dsi-bl-pmic-control-type = "bl_ctrl_dcs";
		qcom,mdss-dsi-reset-sequence = <0x1 0x14 0x0 0x14 0x1 0x14>;
	};
};
