/* Copyright (c) 2014, The Linux Foundation. All rights reserved.
 *
 * This program is free software; you can redistribute it and/or modify
 * it under the terms of the GNU General Public License version 2 and
 * only version 2 as published by the Free Software Foundation.
 *
 * This program is distributed in the hope that it will be useful,
 * but WITHOUT ANY WARRANTY; without even the implied warranty of
 * MERCHANTABILITY or FITNESS FOR A PARTICULAR PURPOSE.  See the
 * GNU General Public License for more details.
 */

&mdss_mdp {
	dsi_trust_5inch_nt35596_1080p_video: qcom,mdss_dsi_trust_5inch_nt35596_1080p_video {
		qcom,mdss-dsi-panel-name = "trust 5inch nt35596 1080p video mode dsi panel";
		qcom,cont-splash-enabled;
		qcom,mdss-dsi-panel-controller = <&mdss_dsi0>;
		qcom,mdss-dsi-panel-type = "dsi_video_mode";
		qcom,mdss-dsi-panel-destination = "display_1";
		qcom,mdss-dsi-panel-framerate = <0x3c>;
		qcom,mdss-dsi-virtual-channel-id = <0x0>;
		qcom,mdss-dsi-stream = <0x0>;
		qcom,mdss-dsi-panel-width = <0x438>;
		qcom,mdss-dsi-panel-height = <0x780>;
		qcom,mdss-dsi-h-front-porch = <0x64>;
		qcom,mdss-dsi-h-back-porch = <0x52>;
		qcom,mdss-dsi-h-pulse-width = <0x8>;
		qcom,mdss-dsi-h-sync-skew = <0x0>;
		qcom,mdss-dsi-v-back-porch = <0x7>;
		qcom,mdss-dsi-v-front-porch = <0x3>;
		qcom,mdss-dsi-v-pulse-width = <0x2>;
		qcom,mdss-dsi-bpp = <0x18>;
		qcom,mdss-dsi-color-order = "rgb_swap_rgb";
		qcom,mdss-dsi-underflow-color = <0xff>;
		qcom,mdss-dsi-border-color = <0x0>;
		qcom,mdss-dsi-on-command = [29 01 00 00 00 00 02 ff 05 29 01 00 00 00 00 02 fb 01 29 01 00 00 32 00 02 c5 31 29 01 00 00 00 00 02 ff ee 29 01 00 00 00 00 02 fb 01 29 01 00 00 00 00 02 24 4f 29 01 00 00 00 00 02 38 c8 29 01 00 00 00 00 02 39 27 29 01 00 00 00 00 02 1e 77 29 01 00 00 00 00 02 1d 0f 29 01 00 00 00 00 02 7e 71 29 01 00 00 00 00 02 ff 01 29 01 00 00 00 00 02 fb 01 29 01 00 00 00 00 02 00 01 29 01 00 00 00 00 02 01 55 29 01 00 00 00 00 02 02 40 29 01 00 00 00 00 02 05 50 29 01 00 00 00 00 02 06 4a 29 01 00 00 00 00 02 07 24 29 01 00 00 00 00 02 08 0c 29 01 00 00 00 00 02 0b 87 29 01 00 00 00 00 02 0c 87 29 01 00 00 00 00 02 0e b0 29 01 00 00 00 00 02 0f ae 29 01 00 00 00 00 02 11 10 29 01 00 00 00 00 02 12 10 29 01 00 00 00 00 02 13 03 29 01 00 00 00 00 02 14 4a 29 01 00 00 00 00 02 15 12 29 01 00 00 00 00 02 16 12 29 01 00 00 00 00 02 18 00 29 01 00 00 00 00 02 19 77 29 01 00 00 00 00 02 1a 55 29 01 00 00 00 00 02 1b 13 29 01 00 00 00 00 02 1c 00 29 01 00 00 00 00 02 1d 00 29 01 00 00 00 00 02 1e 00 29 01 00 00 00 00 02 1f 00 29 01 00 00 00 00 02 58 82 29 01 00 00 00 00 02 59 02 29 01 00 00 00 00 02 5a 02 29 01 00 00 00 00 02 5b 02 29 01 00 00 00 00 02 5c 82 29 01 00 00 00 00 02 5d 82 29 01 00 00 00 00 02 5e 02 29 01 00 00 00 00 02 5f 02 29 01 00 00 00 00 02 72 31 29 01 00 00 00 00 02 ff 05 29 01 00 00 00 00 02 fb 01 29 01 00 00 00 00 02 00 01 29 01 00 00 00 00 02 01 0b 29 01 00 00 00 00 02 02 0c 29 01 00 00 00 00 02 03 09 29 01 00 00 00 00 02 04 0a 29 01 00 00 00 00 02 05 00 29 01 00 00 00 00 02 06 0f 29 01 00 00 00 00 02 07 10 29 01 00 00 00 00 02 08 00 29 01 00 00 00 00 02 09 00 29 01 00 00 00 00 02 0a 00 29 01 00 00 00 00 02 0b 00 29 01 00 00 00 00 02 0c 00 29 01 00 00 00 00 02 0d 13 29 01 00 00 00 00 02 0e 15 29 01 00 00 00 00 02 0f 17 29 01 00 00 00 00 02 10 01 29 01 00 00 00 00 02 11 0b 29 01 00 00 00 00 02 12 0c 29 01 00 00 00 00 02 13 09 29 01 00 00 00 00 02 14 0a 29 01 00 00 00 00 02 15 00 29 01 00 00 00 00 02 16 0f 29 01 00 00 00 00 02 17 10 29 01 00 00 00 00 02 18 00 29 01 00 00 00 00 02 19 00 29 01 00 00 00 00 02 1a 00 29 01 00 00 00 00 02 1b 00 29 01 00 00 00 00 02 1c 00 29 01 00 00 00 00 02 1d 13 29 01 00 00 00 00 02 1e 15 29 01 00 00 00 00 02 1f 17 29 01 00 00 00 00 02 20 00 29 01 00 00 00 00 02 21 03 29 01 00 00 00 00 02 22 01 29 01 00 00 00 00 02 23 40 29 01 00 00 00 00 02 24 40 29 01 00 00 00 00 02 25 ed 29 01 00 00 00 00 02 29 58 29 01 00 00 00 00 02 2a 12 29 01 00 00 00 00 02 2b 01 29 01 00 00 00 00 02 4b 06 29 01 00 00 00 00 02 4c 11 29 01 00 00 00 00 02 4d 20 29 01 00 00 00 00 02 4e 02 29 01 00 00 00 00 02 4f 02 29 01 00 00 00 00 02 50 20 29 01 00 00 00 00 02 51 61 29 01 00 00 00 00 02 52 01 29 01 00 00 00 00 02 53 63 29 01 00 00 00 00 02 54 77 29 01 00 00 00 00 02 55 ed 29 01 00 00 00 00 02 5b 00 29 01 00 00 00 00 02 5c 00 29 01 00 00 00 00 02 5f 15 29 01 00 00 00 00 02 60 75 29 01 00 00 00 00 02 63 00 29 01 00 00 00 00 02 64 00 29 01 00 00 00 00 02 67 00 29 01 00 00 00 00 02 68 04 29 01 00 00 00 00 02 6c 40 29 01 00 00 00 00 02 7a 80 29 01 00 00 00 00 02 7b a3 29 01 00 00 00 00 02 7c d8 29 01 00 00 00 00 02 7d 60 29 01 00 00 00 00 02 7f 15 29 01 00 00 00 00 02 80 00 29 01 00 00 00 00 02 83 00 29 01 00 00 00 00 02 93 08 29 01 00 00 00 00 02 94 0a 29 01 00 00 00 00 02 8a 00 29 01 00 00 00 00 02 9b 0f 29 01 00 00 00 00 02 ff 01 29 01 00 00 00 00 02 fb 01 29 01 00 00 00 00 02 75 00 29 01 00 00 00 00 02 76 8e 29 01 00 00 00 00 02 77 00 29 01 00 00 00 00 02 78 90 29 01 00 00 00 00 02 79 00 29 01 00 00 00 00 02 7a b2 29 01 00 00 00 00 02 7b 00 29 01 00 00 00 00 02 7c c7 29 01 00 00 00 00 02 7d 00 29 01 00 00 00 00 02 7e d7 29 01 00 00 00 00 02 7f 00 29 01 00 00 00 00 02 80 e9 29 01 00 00 00 00 02 81 00 29 01 00 00 00 00 02 82 f9 29 01 00 00 00 00 02 83 01 29 01 00 00 00 00 02 84 01 29 01 00 00 00 00 02 85 01 29 01 00 00 00 00 02 86 0b 29 01 00 00 00 00 02 87 01 29 01 00 00 00 00 02 88 3a 29 01 00 00 00 00 02 89 01 29 01 00 00 00 00 02 8a 5d 29 01 00 00 00 00 02 8b 01 29 01 00 00 00 00 02 8c 94 29 01 00 00 00 00 02 8d 01 29 01 00 00 00 00 02 8e bc 29 01 00 00 00 00 02 8f 02 29 01 00 00 00 00 02 90 00 29 01 00 00 00 00 02 91 02 29 01 00 00 00 00 02 92 39 29 01 00 00 00 00 02 93 02 29 01 00 00 00 00 02 94 3a 29 01 00 00 00 00 02 95 02 29 01 00 00 00 00 02 96 6b 29 01 00 00 00 00 02 97 02 29 01 00 00 00 00 02 98 a2 29 01 00 00 00 00 02 99 02 29 01 00 00 00 00 02 9a c7 29 01 00 00 00 00 02 9b 02 29 01 00 00 00 00 02 9c fb 29 01 00 00 00 00 02 9d 03 29 01 00 00 00 00 02 9e 20 29 01 00 00 00 00 02 9f 03 29 01 00 00 00 00 02 a0 54 29 01 00 00 00 00 02 a2 03 29 01 00 00 00 00 02 a3 6d 29 01 00 00 00 00 02 a4 03 29 01 00 00 00 00 02 a5 80 29 01 00 00 00 00 02 a6 03 29 01 00 00 00 00 02 a7 81 29 01 00 00 00 00 02 a9 03 29 01 00 00 00 00 02 aa c7 29 01 00 00 00 00 02 ab 03 29 01 00 00 00 00 02 ac f0 29 01 00 00 00 00 02 ad 03 29 01 00 00 00 00 02 ae f8 29 01 00 00 00 00 02 af 03 29 01 00 00 00 00 02 b0 fd 29 01 00 00 00 00 02 b1 03 29 01 00 00 00 00 02 b2 fe 29 01 00 00 00 00 02 b3 00 29 01 00 00 00 00 02 b4 8e 29 01 00 00 00 00 02 b5 00 29 01 00 00 00 00 02 b6 90 29 01 00 00 00 00 02 b7 00 29 01 00 00 00 00 02 b8 b2 29 01 00 00 00 00 02 b9 00 29 01 00 00 00 00 02 ba c7 29 01 00 00 00 00 02 bb 00 29 01 00 00 00 00 02 bc d7 29 01 00 00 00 00 02 bd 00 29 01 00 00 00 00 02 be e9 29 01 00 00 00 00 02 bf 00 29 01 00 00 00 00 02 c0 f9 29 01 00 00 00 00 02 c1 01 29 01 00 00 00 00 02 c2 01 29 01 00 00 00 00 02 c3 01 29 01 00 00 00 00 02 c4 0b 29 01 00 00 00 00 02 c5 01 29 01 00 00 00 00 02 c6 3a 29 01 00 00 00 00 02 c7 01 29 01 00 00 00 00 02 c8 5d 29 01 00 00 00 00 02 c9 01 29 01 00 00 00 00 02 ca 94 29 01 00 00 00 00 02 cb 01 29 01 00 00 00 00 02 cc bc 29 01 00 00 00 00 02 cd 02 29 01 00 00 00 00 02 ce 00 29 01 00 00 00 00 02 cf 02 29 01 00 00 00 00 02 d0 39 29 01 00 00 00 00 02 d1 02 29 01 00 00 00 00 02 d2 3a 29 01 00 00 00 00 02 d3 02 29 01 00 00 00 00 02 d4 6b 29 01 00 00 00 00 02 d5 02 29 01 00 00 00 00 02 d6 a2 29 01 00 00 00 00 02 d7 02 29 01 00 00 00 00 02 d8 c7 29 01 00 00 00 00 02 d9 02 29 01 00 00 00 00 02 da fb 29 01 00 00 00 00 02 db 03 29 01 00 00 00 00 02 dc 20 29 01 00 00 00 00 02 dd 03 29 01 00 00 00 00 02 de 54 29 01 00 00 00 00 02 df 03 29 01 00 00 00 00 02 e0 6d 29 01 00 00 00 00 02 e1 03 29 01 00 00 00 00 02 e2 80 29 01 00 00 00 00 02 e3 03 29 01 00 00 00 00 02 e4 81 29 01 00 00 00 00 02 e5 03 29 01 00 00 00 00 02 e6 c7 29 01 00 00 00 00 02 e7 03 29 01 00 00 00 00 02 e8 f0 29 01 00 00 00 00 02 e9 03 29 01 00 00 00 00 02 ea f8 29 01 00 00 00 00 02 eb 03 29 01 00 00 00 00 02 ec fd 29 01 00 00 00 00 02 ed 03 29 01 00 00 00 00 02 ee fe 29 01 00 00 00 00 02 ef 00 29 01 00 00 00 00 02 f0 03 29 01 00 00 00 00 02 f1 00 29 01 00 00 00 00 02 f2 0b 29 01 00 00 00 00 02 f3 00 29 01 00 00 00 00 02 f4 0d 29 01 00 00 00 00 02 f5 00 29 01 00 00 00 00 02 f6 4a 29 01 00 00 00 00 02 f7 00 29 01 00 00 00 00 02 f8 71 29 01 00 00 00 00 02 f9 00 29 01 00 00 00 00 02 fa 8c 29 01 00 00 00 00 02 ff 02 29 01 00 00 00 00 02 fb 01 29 01 00 00 00 00 02 00 00 29 01 00 00 00 00 02 01 a1 29 01 00 00 00 00 02 02 00 29 01 00 00 00 00 02 03 b6 29 01 00 00 00 00 02 04 00 29 01 00 00 00 00 02 05 c9 29 01 00 00 00 00 02 06 00 29 01 00 00 00 00 02 07 fd 29 01 00 00 00 00 02 08 01 29 01 00 00 00 00 02 09 29 29 01 00 00 00 00 02 0a 01 29 01 00 00 00 00 02 0b 6b 29 01 00 00 00 00 02 0c 01 29 01 00 00 00 00 02 0d 9e 29 01 00 00 00 00 02 0e 01 29 01 00 00 00 00 02 0f eb 29 01 00 00 00 00 02 10 02 29 01 00 00 00 00 02 11 25 29 01 00 00 00 00 02 12 02 29 01 00 00 00 00 02 13 27 29 01 00 00 00 00 02 14 02 29 01 00 00 00 00 02 15 5c 29 01 00 00 00 00 02 16 02 29 01 00 00 00 00 02 17 95 29 01 00 00 00 00 02 18 02 29 01 00 00 00 00 02 19 ba 29 01 00 00 00 00 02 1a 02 29 01 00 00 00 00 02 1b ec 29 01 00 00 00 00 02 1c 03 29 01 00 00 00 00 02 1d 0c 29 01 00 00 00 00 02 1e 03 29 01 00 00 00 00 02 1f 34 29 01 00 00 00 00 02 20 03 29 01 00 00 00 00 02 21 3f 29 01 00 00 00 00 02 22 03 29 01 00 00 00 00 02 23 48 29 01 00 00 00 00 02 24 03 29 01 00 00 00 00 02 25 49 29 01 00 00 00 00 02 26 03 29 01 00 00 00 00 02 27 6b 29 01 00 00 00 00 02 28 03 29 01 00 00 00 00 02 29 7e 29 01 00 00 00 00 02 2a 03 29 01 00 00 00 00 02 2b 8f 29 01 00 00 00 00 02 2d 03 29 01 00 00 00 00 02 2f 9e 29 01 00 00 00 00 02 30 03 29 01 00 00 00 00 02 31 a0 29 01 00 00 00 00 02 32 00 29 01 00 00 00 00 02 33 03 29 01 00 00 00 00 02 34 00 29 01 00 00 00 00 02 35 0b 29 01 00 00 00 00 02 36 00 29 01 00 00 00 00 02 37 0d 29 01 00 00 00 00 02 38 00 29 01 00 00 00 00 02 39 4a 29 01 00 00 00 00 02 3a 00 29 01 00 00 00 00 02 3b 71 29 01 00 00 00 00 02 3d 00 29 01 00 00 00 00 02 3f 8c 29 01 00 00 00 00 02 40 00 29 01 00 00 00 00 02 41 a1 29 01 00 00 00 00 02 42 00 29 01 00 00 00 00 02 43 b6 29 01 00 00 00 00 02 44 00 29 01 00 00 00 00 02 45 c9 29 01 00 00 00 00 02 46 00 29 01 00 00 00 00 02 47 fd 29 01 00 00 00 00 02 48 01 29 01 00 00 00 00 02 49 29 29 01 00 00 00 00 02 4a 01 29 01 00 00 00 00 02 4b 6b 29 01 00 00 00 00 02 4c 01 29 01 00 00 00 00 02 4d 9e 29 01 00 00 00 00 02 4e 01 29 01 00 00 00 00 02 4f eb 29 01 00 00 00 00 02 50 02 29 01 00 00 00 00 02 51 25 29 01 00 00 00 00 02 52 02 29 01 00 00 00 00 02 53 27 29 01 00 00 00 00 02 54 02 29 01 00 00 00 00 02 55 5c 29 01 00 00 00 00 02 56 02 29 01 00 00 00 00 02 58 95 29 01 00 00 00 00 02 59 02 29 01 00 00 00 00 02 5a ba 29 01 00 00 00 00 02 5b 02 29 01 00 00 00 00 02 5c ec 29 01 00 00 00 00 02 5d 03 29 01 00 00 00 00 02 5e 0c 29 01 00 00 00 00 02 5f 03 29 01 00 00 00 00 02 60 34 29 01 00 00 00 00 02 61 03 29 01 00 00 00 00 02 62 3f 29 01 00 00 00 00 02 63 03 29 01 00 00 00 00 02 64 48 29 01 00 00 00 00 02 65 03 29 01 00 00 00 00 02 66 49 29 01 00 00 00 00 02 67 03 29 01 00 00 00 00 02 68 6b 29 01 00 00 00 00 02 69 03 29 01 00 00 00 00 02 6a 7e 29 01 00 00 00 00 02 6b 03 29 01 00 00 00 00 02 6c 8f 29 01 00 00 00 00 02 6d 03 29 01 00 00 00 00 02 6e 9e 29 01 00 00 00 00 02 6f 03 29 01 00 00 00 00 02 70 a0 29 01 00 00 00 00 02 71 00 29 01 00 00 00 00 02 72 fb 29 01 00 00 00 00 02 73 00 29 01 00 00 00 00 02 74 fd 29 01 00 00 00 00 02 75 01 29 01 00 00 00 00 02 76 05 29 01 00 00 00 00 02 77 01 29 01 00 00 00 00 02 78 0d 29 01 00 00 00 00 02 79 01 29 01 00 00 00 00 02 7a 17 29 01 00 00 00 00 02 7b 01 29 01 00 00 00 00 02 7c 1f 29 01 00 00 00 00 02 7d 01 29 01 00 00 00 00 02 7e 28 29 01 00 00 00 00 02 7f 01 29 01 00 00 00 00 02 80 32 29 01 00 00 00 00 02 81 01 29 01 00 00 00 00 02 82 38 29 01 00 00 00 00 02 83 01 29 01 00 00 00 00 02 84 53 29 01 00 00 00 00 02 85 01 29 01 00 00 00 00 02 86 72 29 01 00 00 00 00 02 87 01 29 01 00 00 00 00 02 88 9b 29 01 00 00 00 00 02 89 01 29 01 00 00 00 00 02 8a c3 29 01 00 00 00 00 02 8b 02 29 01 00 00 00 00 02 8c 01 29 01 00 00 00 00 02 8d 02 29 01 00 00 00 00 02 8e 36 29 01 00 00 00 00 02 8f 02 29 01 00 00 00 00 02 90 37 29 01 00 00 00 00 02 91 02 29 01 00 00 00 00 02 92 69 29 01 00 00 00 00 02 93 02 29 01 00 00 00 00 02 94 a1 29 01 00 00 00 00 02 95 02 29 01 00 00 00 00 02 96 c8 29 01 00 00 00 00 02 97 02 29 01 00 00 00 00 02 98 ff 29 01 00 00 00 00 02 99 03 29 01 00 00 00 00 02 9a 26 29 01 00 00 00 00 02 9b 03 29 01 00 00 00 00 02 9c 69 29 01 00 00 00 00 02 9d 03 29 01 00 00 00 00 02 9e 88 29 01 00 00 00 00 02 9f 03 29 01 00 00 00 00 02 a0 f8 29 01 00 00 00 00 02 a2 03 29 01 00 00 00 00 02 a3 f9 29 01 00 00 00 00 02 a4 03 29 01 00 00 00 00 02 a5 fe 29 01 00 00 00 00 02 a6 03 29 01 00 00 00 00 02 a7 fe 29 01 00 00 00 00 02 a9 03 29 01 00 00 00 00 02 aa fe 29 01 00 00 00 00 02 ab 03 29 01 00 00 00 00 02 ac fe 29 01 00 00 00 00 02 ad 03 29 01 00 00 00 00 02 ae fe 29 01 00 00 00 00 02 af 00 29 01 00 00 00 00 02 b0 fb 29 01 00 00 00 00 02 b1 00 29 01 00 00 00 00 02 b2 fd 29 01 00 00 00 00 02 b3 01 29 01 00 00 00 00 02 b4 05 29 01 00 00 00 00 02 b5 01 29 01 00 00 00 00 02 b6 0d 29 01 00 00 00 00 02 b7 01 29 01 00 00 00 00 02 b8 17 29 01 00 00 00 00 02 b9 01 29 01 00 00 00 00 02 ba 1f 29 01 00 00 00 00 02 bb 01 29 01 00 00 00 00 02 bc 28 29 01 00 00 00 00 02 bd 01 29 01 00 00 00 00 02 be 32 29 01 00 00 00 00 02 bf 01 29 01 00 00 00 00 02 c0 38 29 01 00 00 00 00 02 c1 01 29 01 00 00 00 00 02 c2 53 29 01 00 00 00 00 02 c3 01 29 01 00 00 00 00 02 c4 72 29 01 00 00 00 00 02 c5 01 29 01 00 00 00 00 02 c6 9b 29 01 00 00 00 00 02 c7 01 29 01 00 00 00 00 02 c8 c3 29 01 00 00 00 00 02 c9 02 29 01 00 00 00 00 02 ca 01 29 01 00 00 00 00 02 cb 02 29 01 00 00 00 00 02 cc 36 29 01 00 00 00 00 02 cd 02 29 01 00 00 00 00 02 ce 37 29 01 00 00 00 00 02 cf 02 29 01 00 00 00 00 02 d0 69 29 01 00 00 00 00 02 d1 02 29 01 00 00 00 00 02 d2 a1 29 01 00 00 00 00 02 d3 02 29 01 00 00 00 00 02 d4 c8 29 01 00 00 00 00 02 d5 02 29 01 00 00 00 00 02 d6 ff 29 01 00 00 00 00 02 d7 03 29 01 00 00 00 00 02 d8 26 29 01 00 00 00 00 02 d9 03 29 01 00 00 00 00 02 da 69 29 01 00 00 00 00 02 db 03 29 01 00 00 00 00 02 dc 88 29 01 00 00 00 00 02 dd 03 29 01 00 00 00 00 02 de f8 29 01 00 00 00 00 02 df 03 29 01 00 00 00 00 02 e0 f9 29 01 00 00 00 00 02 e1 03 29 01 00 00 00 00 02 e2 fe 29 01 00 00 00 00 02 e3 03 29 01 00 00 00 00 02 e4 fe 29 01 00 00 00 00 02 e5 03 29 01 00 00 00 00 02 e6 fe 29 01 00 00 00 00 02 e7 03 29 01 00 00 00 00 02 e8 fe 29 01 00 00 00 00 02 e9 03 29 01 00 00 00 00 02 ea fe 29 01 00 00 00 00 02 ff 01 29 01 00 00 00 00 02 fb 01 29 01 00 00 00 00 02 ff 02 29 01 00 00 00 00 02 fb 01 29 01 00 00 00 00 02 ff 04 29 01 00 00 00 00 02 fb 01 29 01 00 00 00 00 02 ff 00 29 01 00 00 00 00 02 d3 05 29 01 00 00 00 00 02 d4 04 29 01 00 00 00 00 02 51 00 29 01 00 00 00 00 02 53 2c 29 01 00 00 00 00 02 55 00 29 01 00 00 78 00 01 11 29 01 00 00 00 00 02 ff 00 29 01 00 00 00 00 02 35 00 29 01 00 00 3c 00 01 29];
		qcom,mdss-dsi-off-command = [05 01 00 00 32 00 02 28 00 05 01 00 00 78 00 02 10 00];
		qcom,mdss-dsi-on-command-state = "dsi_lp_mode";
		qcom,mdss-dsi-off-command-state = "dsi_hs_mode";
		qcom,mdss-dsi-h-sync-pulse = <0x1>;
		qcom,mdss-dsi-traffic-mode = "burst_mode";
		qcom,mdss-dsi-lane-map = "lane_map_0123";
		qcom,mdss-dsi-bllp-eof-power-mode;
		qcom,mdss-dsi-bllp-power-mode;
		qcom,mdss-dsi-lane-0-state;
		qcom,mdss-dsi-lane-1-state;
		qcom,mdss-dsi-lane-2-state;
		qcom,mdss-dsi-lane-3-state;
		qcom,mdss-dsi-panel-timings = <0x9e433700 0x60583945 0x5b030400>;
		qcom,mdss-dsi-t-clk-post = <0x1e>;
		qcom,mdss-dsi-t-clk-pre = <0x38>;
		qcom,mdss-dsi-bl-min-level = <0x1>;
		qcom,mdss-dsi-bl-max-level = <0xff>;
		qcom,mdss-dsi-dma-trigger = "trigger_sw";
		qcom,mdss-dsi-mdp-trigger = "none";
		qcom,mdss-dsi-bl-pmic-control-type = "bl_ctrl_dcs";
		qcom,mdss-dsi-reset-sequence = <0x1 0x14 0x0 0x14 0x1 0x14>;
	};

};
